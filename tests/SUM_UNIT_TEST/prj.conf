## CMakeLists.txt
```
cmake_minimum_required(VERSION 3.20.0)

find_package(Zephyr REQUIRED HINTS $ENV{ZEPHYR_BASE})
project(sum_unit_test)

if(EXISTS "${CMAKE_CURRENT_LIST_DIR}/../../lab0_app")
  set(LAB0_APP_DIR "${CMAKE_CURRENT_LIST_DIR}/../../lab0_app")
else()
  set(LAB0_APP_DIR "${CMAKE_CURRENT_LIST_DIR}/../../lab0-app")
endif()

target_include_directories(app PRIVATE ${LAB0_APP_DIR}/include)

target_sources(app PRIVATE
  src/main.c
  ${LAB0_APP_DIR}/src/sum_printk/sum_printk.c
)
```

## prj.conf
```kconfig
CONFIG_LOG=y
CONFIG_ZTEST=y
CONFIG_ZTEST_ASSERT_VERBOSE=2
```

## src/main.c
```c
#include <zephyr/ztest.h>
#include "sum.h"

ZTEST(sum_tests, test_sum_positive)
{
    zassert_equal(sum(1, 2), 3, "1 + 2 should equal 3");
}

ZTEST(sum_tests, test_sum_negative)
{
    zassert_equal(sum(-4, -5), -9, "-4 + -5 should equal -9");
}

ZTEST(sum_tests, test_sum_zero)
{
    zassert_equal(sum(0, 0), 0, "0 + 0 should equal 0");
}

ZTEST_SUITE(sum_tests, NULL, NULL, NULL, NULL, NULL);
```
