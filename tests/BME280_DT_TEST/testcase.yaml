## tests/BME280_DT_TEST/testcase.yaml
```yaml
tests:
  lab0.bme280_dt:
    platform_allow:
      - qemu_cortex_m3
    harness: ztest
    tags: lab0 bme280 devicetree
```

## tests/SUM_UNIT_TEST/testcase.yaml
```yaml
tests:
  lab0.sum:
    platform_allow:
      - qemu_cortex_m3
      - nrf7002dk_nrf5340_cpuapp_ns
    harness: ztest
    tags: lab0 sum
```
